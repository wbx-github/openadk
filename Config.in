## package/u-boot/patches/patch-configs_rock-pi-4-rk3399_defconfig
```kconfig
--- u-boot-2026.01.orig/configs/rock-pi-4-rk3399_defconfig	2026-01-05 21:49:22.000000000 +0100
+++ u-boot-2026.01/configs/rock-pi-4-rk3399_defconfig	2026-02-20 22:19:46.405180702 +0100
@@ -76,7 +76,7 @@ CONFIG_REGULATOR_RK8XX=y
 CONFIG_PWM_ROCKCHIP=y
 CONFIG_RAM_ROCKCHIP_LPDDR4=y
 CONFIG_SCSI=y
-CONFIG_BAUDRATE=1500000
+CONFIG_BAUDRATE=115200
 CONFIG_DEBUG_UART_SHIFT=2
 CONFIG_SYS_NS16550_MEM32=y
 CONFIG_ROCKCHIP_SPI=y
```

## package/u-boot/patches/patch-configs_rock-pi-4c-rk3399_defconfig
```kconfig
--- u-boot-2023.07.02.orig/configs/rock-pi-4c-rk3399_defconfig	2023-07-11 17:20:44.000000000 +0200
+++ u-boot-2023.07.02/configs/rock-pi-4c-rk3399_defconfig	2023-09-29 15:54:16.927583546 +0200
@@ -67,7 +67,7 @@ CONFIG_REGULATOR_PWM=y
 CONFIG_REGULATOR_RK8XX=y
 CONFIG_PWM_ROCKCHIP=y
 CONFIG_RAM_ROCKCHIP_LPDDR4=y
-CONFIG_BAUDRATE=1500000
+CONFIG_BAUDRATE=115200
 CONFIG_DEBUG_UART_SHIFT=2
 CONFIG_SYS_NS16550_MEM32=y
 CONFIG_SYSRESET=y
```

## target/config/Config.in
```kconfig
# This file is part of the OpenADK project. OpenADK is copyrighted
# material, please see the LICENCE file in the top-level directory.

# global symbols
config ADK_LINUX_64
	bool

config ADK_TARGET_KERNEL_64
	bool

config ADK_TARGET_GENERIC
	bool
	select ADK_TARGET_WITH_NET
	select ADK_TARGET_WITH_NETDEVICE

config ADK_TARGET_UCLINUX
	bool

config ADK_TARGET_SIM
	bool
	select ADK_TOOLCHAIN_WITH_GDB

config ADK_TARGET_QEMU
	bool
	select ADK_TARGET_WITH_NET
	select ADK_TARGET_WITH_NETDEVICE

# the inverse of ADK_TARGET_KERNEL_CUSTOMISING,
# allows for selecting it off (i.e., to disable it)
config ADK_TARGET_FIXED_KERNEL
	bool

config ADK_TARGET_KERNEL_CUSTOMISING
	bool
	depends on !ADK_TARGET_FIXED_KERNEL
	default y

source "target/config/Config.in.tools"
```

## target/linux/Config.in
```kconfig
# This file is part of the OpenADK project. OpenADK is copyrighted
# material, please see the LICENCE file in the top-level directory.

source target/linux/config/Config.in.kernel
source target/linux/config/Config.in.cpu
source target/linux/config/Config.in.bus
source target/linux/config/Config.in.block
source target/linux/config/Config.in.flash
source target/linux/config/Config.in.fs
source target/linux/config/Config.in.netdevice
source target/linux/config/Config.in.usb
source target/linux/config/Config.in.serial
source target/linux/config/Config.in.graphics
source target/linux/config/Config.in.input
source target/linux/config/Config.in.pcmcia
source target/linux/config/Config.in.network
source target/linux/config/Config.in.netfilter
source target/linux/config/Config.in.audio
source target/linux/config/Config.in.multimedia
source target/linux/config/Config.in.crypto
source target/linux/config/Config.in.misc
source target/linux/config/Config.in.arc
source target/linux/config/Config.in.arm
source target/linux/config/Config.in.m68k
source target/linux/config/Config.in.mips
source target/linux/config/Config.in.xtensa
source target/linux/config/Config.in.pm
source target/linux/config/Config.in.kvm
source target/linux/config/Config.in.virtio
source target/linux/config/Config.in.debug
```
