## Config.in
```kconfig
# This file is part of the OpenADK project. OpenADK is copyrighted
# material, please see the LICENCE file in the top-level directory.

mainmenu "OpenADK Configuration"

# enable tristate
config ADK_MODULES
	bool
	option modules
	default y

config ADK_HAVE_DOT_CONFIG
	bool
	default y

source "target/config/Config.in"
source "target/config/Config.in.os"
source "target/config/Config.in.hardware"
source "target/config/Config.in.boards"
source "target/config/Config.in.kernelfmt"

menu "Hardware configuration"
source "target/config/Config.in.arch"
source "target/config/Config.in.system"
source "target/config/Config.in.subsystem"
source "target/config/Config.in.qemuopts"
source "target/config/Config.in.endian"
source "target/config/Config.in.mmu"
source "target/config/Config.in.cpu"
source "target/config/Config.in.addons"
endmenu

menu "C Library configuration"
	visible if ADK_TARGET_OS_LINUX || ADK_TARGET_OS_BAREMETAL && !ADK_TARGET_CHOOSE_ARCH
source "target/config/Config.in.libc"
source "target/config/Config.in.threads"
source "target/config/Config.in.binfmt"
source "target/config/Config.in.instructions"
source "target/config/Config.in.fpu"
source "target/config/Config.in.float"
source "target/config/Config.in.abi"
source "target/config/Config.in.libs"
source "target/config/Config.in.uclibc-ng"
endmenu

comment "After you saved your configuration once, you shouldn't change anything above"
	depends on ADK_TARGET_OS_LINUX && !ADK_APPLIANCE_TOOLCHAIN && !ADK_TARGET_CHOOSE_ARCH

source "target/config/Config.in.tasks"

menu "Firmware configuration"
	visible if ADK_TARGET_OS_LINUX && !ADK_APPLIANCE_TOOLCHAIN && !ADK_TARGET_CHOOSE_ARCH
source "target/config/Config.in.rootfs"
endmenu

menu "Package selection"
	visible if ADK_TARGET_OS_LINUX && !ADK_APPLIANCE_TOOLCHAIN && !ADK_TARGET_CHOOSE_ARCH
source "package/Config.in.auto.global"
source "package/Config.in"
menu "Package options"
source "package/Config.in.options"
endmenu
endmenu

menu "Runtime configuration"
	visible if ADK_TARGET_OS_LINUX && !ADK_APPLIANCE_TOOLCHAIN && !ADK_TARGET_CHOOSE_ARCH
source "target/config/Config.in.runtime"
endmenu

menu "Linux Kernel configuration"
	visible if ADK_TARGET_OS_LINUX && !ADK_TARGET_CHOOSE_ARCH
source "target/linux/Config.in.kernelversion"
source "target/linux/Config.in.kernelcfg"
source "target/linux/config/Config.in.compression"
source "target/config/Config.in.cmdline"

menu "Advanced Linux Kernel configuration"
	visible if ADK_TARGET_OS_LINUX && ADK_TARGET_KERNEL_CUSTOMISING && !ADK_APPLIANCE_TOOLCHAIN && !ADK_TARGET_CHOOSE_ARCH && !ADK_TARGET_LINUX_KERNEL_USE_DEFCONFIG && !ADK_TARGET_LINUX_KERNEL_USE_CUSTOMCONFIG && !ADK_TARGET_NO_KERNEL
source "target/linux/Config.in"
endmenu
endmenu

menu "Toolchain settings"
	visible if !ADK_TARGET_CHOOSE_ARCH

source "target/config/Config.in.binutils"
source "target/config/Config.in.compiler"
source "target/config/Config.in.gdb"
source "target/config/Config.in.toolchain"
endmenu

source "target/config/Config.in.adk"
```

## package/Config.in
```kconfig
menu "Base system"
source package/Config.in.auto.base.boot
source package/Config.in.auto.base.libs
source package/Config.in.auto.base.apps
source package/Config.in.auto.base.tools
source package/Config.in.auto.base.init
source package/Config.in.auto.base.adk
source package/Config.in.auto.base.shells
source package/Config.in.auto.base.tests
endmenu

menu "System"
source package/Config.in.auto.sys.drivers
source package/Config.in.auto.sys.fs
source package/Config.in.auto.sys.serial
source package/Config.in.auto.sys.utils
source package/Config.in.auto.sys.hw
source package/Config.in.auto.sys.firmware
source package/Config.in.auto.sys.misc
endmenu

menu "Applications"
source package/Config.in.auto.app.archive
source package/Config.in.auto.app.browser
source package/Config.in.auto.app.chat
source package/Config.in.auto.app.crypto
source package/Config.in.auto.app.debug
source package/Config.in.auto.app.editor
source package/Config.in.auto.app.games
source package/Config.in.auto.app.p2p
endmenu

menu "Networking"
source package/Config.in.auto.net.acct
source package/Config.in.auto.net.dns
source package/Config.in.auto.net.debug
source package/Config.in.auto.net.firewall
source package/Config.in.auto.net.fs
source package/Config.in.auto.net.http
source package/Config.in.auto.net.ipv6
source package/Config.in.auto.net.mail
source package/Config.in.auto.net.misc
source package/Config.in.auto.net.ntp
source package/Config.in.auto.net.perf
source package/Config.in.auto.net.ppp
source package/Config.in.auto.net.proxy
source package/Config.in.auto.net.radius
source package/Config.in.auto.net.route
source package/Config.in.auto.net.security
source package/Config.in.auto.net.voip
source package/Config.in.auto.net.wifi
endmenu

menu "Multimedia"
source package/Config.in.auto.mm.audio
source package/Config.in.auto.mm.image
source package/Config.in.auto.mm.video
endmenu

menu "Xorg"
source package/Config.in.auto.x11.apps
source package/Config.in.auto.x11.utils
source package/Config.in.auto.x11.drivers
source package/Config.in.auto.x11.misc
source package/Config.in.auto.x11.fonts
source package/Config.in.auto.x11.libs
endmenu

menu "Libraries"
source package/Config.in.auto.libs.audio
source package/Config.in.auto.libs.comp
source package/Config.in.auto.libs.crypto
source package/Config.in.auto.libs.data
source package/Config.in.auto.libs.db
source package/Config.in.auto.libs.fonts
source package/Config.in.auto.libs.image
source package/Config.in.auto.libs.misc
source package/Config.in.auto.libs.net
source package/Config.in.auto.libs.qt
source package/Config.in.auto.libs.video
endmenu

menu "Programming"
source package/Config.in.auto.dev.lang
source package/Config.in.auto.dev.python
source package/Config.in.auto.dev.perl
source package/Config.in.auto.dev.scm
source package/Config.in.auto.dev.tools
endmenu
```
